## arch/arm/src/arm_a_r/Kconfig
```kconfig
#
# For a description of the syntax of this configuration file,
# see the file kconfig-language.txt in the NuttX tools repository.
#

comment "ARM_A_R Configuration Options"

config ARM_PSCI_SERVER
	bool "PSCI server in secure monitor"
	default n
	depends on ARCH_TRUSTZONE_SECURE
	---help---
		Enable PSCI server implementation in the secure monitor.
		When enabled, the TEE secure monitor handles PSCI calls
		(SYSTEM_RESET, SYSTEM_OFF, etc.) from the non-secure world
		via semihosting. This is needed when QEMU is launched with
		-bios which disables the built-in PSCI firmware.

config ARM_FLASH_ICACHE_WAYS
	int "Instruction cache Flash ways"
	range 0 4
	default 1
	depends on BOOT_RUNFROMFLASH
	depends on !ARM_ICACHE_DISABLE
	---help---
		Number of instruction cache ways assigned to Flash. The
		remaining ways are assigned to AXIM.

config ARM_FLASH_DCACHE_WAYS
	int "Data cache Flash ways"
	range 0 4
	default 3
	depends on BOOT_RUNFROMFLASH
	depends on !ARM_DCACHE_DISABLE
	---help---
		Number of data cache ways assigned to Flash. The remaining
		ways are assigned to AXIM.
```

## drivers/dma-buf/Kconfig
```kconfig
#
# For a description of the syntax of this configuration file,
# see the file kconfig-language.txt in the NuttX tools repository.
#

config DMA_SHARED_BUFFER
	bool
	default n
	---help---
		This option enables the framework for buffer-sharing between
		multiple drivers. A buffer is associated with a file using driver
		APIs extension; the file's descriptor can then be passed on to other
		driver.

config DMABUF_HEAPS
	bool "DMA-BUF Userland Memory Heaps"
	default n
	select DMA_SHARED_BUFFER
	---help---
		Choose this option to enable the DMA-BUF userland memory heaps.
		This options creates per heap chardevs in /dev/dma_heap/ which
		allows userspace to allocate dma-bufs that can be shared
		between drivers.

config DMABUF_SYSTEM_HEAP_RESERVE_SIZE
	int "DMA-BUF system heap reserved region size"
	default 0
	depends on DMABUF_HEAPS
	---help---
		Reserve a private region at startup for system DMA-BUF
		allocations.  Allocations use this region first and fall back to
		the public heap when the region has insufficient space.

		A value of zero keeps the existing public heap allocation path.
```

## drivers/fault/Kconfig
```kconfig
#
# For a description of the syntax of this configuration file,
# see the file kconfig-language.txt in the NuttX tools repository.
#

menuconfig DRIVERS_FAULT_INJECT
	bool "Fault Injection Framework"
	default n
	---help---
		Generic fault-injection framework for NuttX.  Provides per-site
		policy + executor split, a wrapper macro family for zero-touch
		integration, an embedded macro family for register / exception
		injection, and optional audit records routed through sched_note.

		The framework core does not depend on sched_note; only the
		optional audit stream (DRIVERS_FAULT_INJECT_AUDIT) does.

		Disabled by default.  When this option is off no fault-injection
		symbol is emitted into the final image (`nm out/nuttx |
		grep -i fault_inject` returns no matches).

if DRIVERS_FAULT_INJECT

config DRIVERS_FAULT_INJECT_AUDIT
	bool "Emit audit records via sched_note"
	depends on SCHED_INSTRUMENTATION_DUMP && DRIVERS_NOTE
	default y
	---help---
		Append a structured fault_audit_record_s into the sched_note
		stream (under NXTAG_SAFETY) every time an injection fires.

		Only available when the platform provides a sched_note dump
		backend.  When unavailable this option is hidden and the
		framework runs without an audit stream.

config DRIVERS_FAULT_INJECT_VERBOSE
	bool "Verbose logging"
	default n
	---help---
		Emit verbose `finfo` logs from the framework hot path.  Useful
		during framework bring-up; off in production.

comment "Standby RAM support"

config DRIVERS_FAULT_INJECT_STANDBY
	bool "Standby RAM fault points (persist across warm reset)"
	default n
	---help---
		Place FAULT_INJECT_*_STANDBY points in a dedicated linker
		section (.fi_standby) that survives warm reset.

		The board linker script must:
		  1. Place .fi_standby in standby RAM (NOLOAD)
		  2. Provide __start_fi_standby / __stop_fi_standby symbols

comment "Wrapper-based injection points"

config DRIVERS_FAULT_INJECT_WRAP_MM
	bool "mm_* wrappers (malloc/free/realloc/calloc/zalloc/memalign)"
	default n
	---help---
		Build the __wrap_mm_* implementations in drivers/fault/
		wraps/fault_wrap_mm.c.  The board build must arrange for the kernel
		image to consume fault_wrapsymbol.cmd (via the wrapsymbol tool
		or GNU ld --wrap=) so the in-image callers are redirected to
		these wrappers.  Without that integration, the wrappers are
		dead code at link time.

config DRIVERS_FAULT_INJECT_WRAP_IRQ
	bool "irq_* wrappers (attach/attach_thread/attach_wqueue/up_*_irq)"
	default n
	---help---
		Build the __wrap_irq_* implementations in drivers/fault/
		wraps/fault_wrap_irq.c.  Same board-integration requirement as
		DRIVERS_FAULT_INJECT_WRAP_MM.

config DRIVERS_FAULT_INJECT_WRAP_FS
	bool "fs/VFS wrappers (file_readv/file_writev/register_driver/inode_find)"
	default n
	---help---
		Build the __wrap_* implementations in
		drivers/fault/wraps/fault_wrap_fs.c.  Covers the read/write
		(file_readv/file_writev), driver registration (register_driver)
		and inode lookup (inode_find) paths.

		The open series (nx_open/file_open) is intentionally excluded
		because both are variadic and ld --wrap cannot forward va_list.
		Same board-integration requirement as DRIVERS_FAULT_INJECT_WRAP_MM.

config DRIVERS_FAULT_INJECT_WRAP_SEM
	bool "semaphore wrappers (nxsem_*_slow)"
	default n
	---help---
		Build the __wrap_nxsem_*_slow implementations in
		drivers/fault/wraps/fault_wrap_sem.c.  The slow-path symbols
		(nxsem_wait_slow/trywait_slow/post_slow/tickwait_slow/
		clockwait_slow) are wrapped rather than the inline fast-path
		variants, which ld --wrap cannot intercept.

		Same board-integration requirement as DRIVERS_FAULT_INJECT_WRAP_MM.

config DRIVERS_FAULT_INJECT_WRAP_MQ
	bool "mqueue wrappers (nxmq_send/nxmq_receive/file_mq_send/file_mq_receive)"
	default n
	---help---
		Build the __wrap_* implementations in
		drivers/fault/wraps/fault_wrap_mq.c.  Covers the kernel-side
		POSIX message queue send/receive paths.

		Same board-integration requirement as DRIVERS_FAULT_INJECT_WRAP_MM.

config DRIVERS_FAULT_INJECT_WRAP_WQ
	bool "workqueue wrappers (work_queue/work_queue_wq/work_cancel)"
	default n
	---help---
		Build the __wrap_* implementations in
		drivers/fault/wraps/fault_wrap_wq.c.  Covers the kernel work
		queue submit/cancel paths.

		Operationally prefer SKIP / RETURN_ERR actions; the DELAY action
		is unsafe here because waking a worker re-enters work_queue()
		under a spinlock.  In a flat build without CONFIG_LIBC_USRWORK
		there is no work_queue/work_cancel symbol ambiguity; work_queue_wq
		is kernel-only and always unambiguous.

		Same board-integration requirement as DRIVERS_FAULT_INJECT_WRAP_MM.

config DRIVERS_FAULT_INJECT_WRAP_SPI
	bool "spi wrapper (spi_transfer)"
	depends on SPI && SPI_EXCHANGE
	default n
	---help---
		Build the __wrap_spi_transfer implementation in
		drivers/fault/wraps/fault_wrap_spi.c.  spi_transfer() is the
		global SPI transfer-sequence entry point (drivers/spi/
		spi_transfer.c); it is a real function symbol, not an ops vtable
		method, so ld --wrap can intercept it.

		Only the global spi_transfer() path is wrapped.  Per-device ops
		invoked through SPI_SEND / SPI_EXCHANGE macros resolve through
		dev->ops and cannot be intercepted by ld --wrap.

		Same board-integration requirement as DRIVERS_FAULT_INJECT_WRAP_MM.

config DRIVERS_FAULT_INJECT_WRAP_I2C
	bool "i2c wrappers (i2c_read/i2c_write/i2c_writeread)"
	depends on I2C
	default n
	---help---
		Build the __wrap_i2c_* implementations in
		drivers/fault/wraps/fault_wrap_i2c.c.  Covers the global I2C
		convenience helpers i2c_read() / i2c_write() / i2c_writeread()
		(drivers/i2c/i2c_{read,write,writeread}.c).

		These are real function symbols, not ops vtable methods.  The
		lower-level I2C_TRANSFER() macro path resolves through dev->ops
		and cannot be intercepted by ld --wrap.

		Same board-integration requirement as DRIVERS_FAULT_INJECT_WRAP_MM.

config DRIVERS_FAULT_INJECT_WRAP_CAN
	bool "can wrappers (can_receive/can_txready)"
	depends on CAN
	default n
	---help---
		Build the __wrap_can_* implementations in
		drivers/fault/wraps/fault_wrap_can.c.  Wraps the CAN upper-half
		entry points can_receive() (RX FIFO push, driven from the RX IRQ)
		and can_txready() (drivers/can/can.c).

		can_receive() / can_txready() normally run in IRQ context:
		prefer RETURN_ERR / SKIP.  The DELAY action is declared supported
		but runs up_udelay() with no IRQ-context guard, so arming DELAY
		here busy-waits inside the ISR and harms interrupt latency; avoid
		it unless that cost is acceptable.

		Same board-integration requirement as DRIVERS_FAULT_INJECT_WRAP_MM.

config DRIVERS_FAULT_INJECT_WRAP_CLK
	bool "clk wrappers (clk_enable/clk_set_rate)"
	depends on CLK
	default n
	---help---
		Build the __wrap_clk_* implementations in
		drivers/fault/wraps/fault_wrap_clk.c.  Covers the global clock
		management entry points clk_enable() and clk_set_rate()
		(drivers/clk/clk.c).

		Same board-integration requirement as DRIVERS_FAULT_INJECT_WRAP_MM.

config DRIVERS_FAULT_INJECT_WRAP_RESET
	bool "reset wrappers (reset_control_reset/assert_reason, deassert)"
	depends on RESET
	default n
	---help---
		Build the __wrap_reset_control_* implementations in
		drivers/fault/wraps/fault_wrap_reset.c.  Wraps the real global
		reset-controller functions reset_control_reset_reason(),
		reset_control_assert_reason() and reset_control_deassert()
		(drivers/reset/core.c).

		The plain reset_control_reset() / reset_control_assert() helpers
		are static inline wrappers in <nuttx/reset/reset.h> that forward
		to the _reason() functions, so their callers are already covered
		through the wrapped _reason() symbols.

		Same board-integration requirement as DRIVERS_FAULT_INJECT_WRAP_MM.

endif # DRIVERS_FAULT_INJECT
```

## drivers/reset/Kconfig
```kconfig
#
# For a description of the syntax of this configuration file,
# see the file kconfig-language.txt in the NuttX tools repository.
#

config RESET
	bool
	default n
	---help---
		This selection enables building of the "upper-half" reset driver.
		Selected by the drivers that need it, not chosen directly.

config RESET_RPMSG
	bool "Reset rpmsg driver support"
	depends on RPTUN
	select RESET
	default n
	---help---
		This selection enables rpmsg support for reset.

config RESET_IPC
	bool "Inter-Processor panic/reset notify support"
	select RESET
	default n
	---help---
		RESET_IPC provides the multicore panic/reset coordination
		mechanism (pause/panic/poweroff/stop handshake over a pair of
		shared status words plus an IPI) shared by transports such as
		RPTUN and RPMSG_BMP.  Each registered channel also exposes the
		peer core to the reset framework, with one reset line per reset
		reason (line id == BOARDIOC_SOFTRESETCAUSE_xxx).  It is selected
		automatically by the transports that use it.

if RESET_IPC

config RESET_IPC_REMOTE_PANIC_SILENT
	bool "Silence syslog on remote-triggered panic"
	default n
	---help---
		When a remote core triggers a panic on this core, silence
		all syslog output by setting logmask to LOG_NONE.  The log
		mask is restored at PANIC_KERNEL_FINAL before coredump and
		RAMLOG dump, so only the originating core's crash log is
		printed during the panic sequence.

config RESET_IPC_STATUS_TIMEOUT_MS
	int "reset_ipc status timeout ms"
	default 5000

endif # RESET_IPC
```

## net/ipfilter/Kconfig
```kconfig
#
# For a description of the syntax of this configuration file,
# see the file kconfig-language.txt in the NuttX tools repository.
#

config NET_IPFILTER
	bool "Enable IP packet filter (firewall)"
	default n
	depends on NET_IPv4 || NET_IPv6
	---help---
		Enable this option to enable the IP packet filter (firewall).
		Our IP packet filter is a netfilter-like packet filter that
		operates on the IP (and transport) layer.  It is a stateless
		packet filter that can be used to filter packets based on
		source and destination IP addresses, source and destination
		ports, protocol, and interface.

if NET_IPFILTER

config NET_IPFILTER_POOL_ALLOC
	int "Dynamic IP filter entry allocation"
	default 1
	range 0 65535
	---help---
		Number of IP filter entries allocated from the heap each time
		the static pool is exhausted. Set to 0 to disable dynamic
		allocation. A value of 1 allocates and frees entries individually;
		larger values allocate entries in batches that remain in the pool.

config NET_IPFILTER_POOL_MAX
	int "Maximum IP filter entries"
	depends on NET_IPFILTER_POOL_ALLOC > 0
	default 0
	range 0 65535
	---help---
		Maximum number of IP filter entries in each pool, including both
		statically pre-allocated and dynamically allocated entries. Set to
		0 for no limit. If set below a pool's static count, the static count
		is used as the effective maximum.

if BMP

config NET_IPFILTER_POOL_PREALLOC_CPU0
	int "Pre-allocated IP filter entries for CPU0"
	default 0
	range 0 65535
	---help---
		Number of statically pre-allocated IP filter entries for CPU0.
		IPv4 and IPv6 rules share this pool. Set to 0 to disable IP
		filter rule allocation on this CPU.

config NET_IPFILTER_POOL_SECTION_CPU0
	string "Section name of IP filter entry pool for CPU0"

if NCPUS > 1

config NET_IPFILTER_POOL_PREALLOC_CPU1
	int "Pre-allocated IP filter entries for CPU1"
	default 0
	range 0 65535
	---help---
		Number of statically pre-allocated IP filter entries for CPU1.
		IPv4 and IPv6 rules share this pool. Set to 0 to disable IP
		filter rule allocation on this CPU.

config NET_IPFILTER_POOL_SECTION_CPU1
	string "Section name of IP filter entry pool for CPU1"

endif # NCPUS > 1

if NCPUS > 2

config NET_IPFILTER_POOL_PREALLOC_CPU2
	int "Pre-allocated IP filter entries for CPU2"
	default 0
	range 0 65535
	---help---
		Number of statically pre-allocated IP filter entries for CPU2.
		IPv4 and IPv6 rules share this pool. Set to 0 to disable IP
		filter rule allocation on this CPU.

config NET_IPFILTER_POOL_SECTION_CPU2
	string "Section name of IP filter entry pool for CPU2"

endif # NCPUS > 2

if NCPUS > 3

config NET_IPFILTER_POOL_PREALLOC_CPU3
	int "Pre-allocated IP filter entries for CPU3"
	default 0
	range 0 65535
	---help---
		Number of statically pre-allocated IP filter entries for CPU3.
		IPv4 and IPv6 rules share this pool. Set to 0 to disable IP
		filter rule allocation on this CPU.

config NET_IPFILTER_POOL_SECTION_CPU3
	string "Section name of IP filter entry pool for CPU3"

endif # NCPUS > 3

if NCPUS > 4

config NET_IPFILTER_POOL_PREALLOC_CPU4
	int "Pre-allocated IP filter entries for CPU4"
	default 0
	range 0 65535
	---help---
		Number of statically pre-allocated IP filter entries for CPU4.
		IPv4 and IPv6 rules share this pool. Set to 0 to disable IP
		filter rule allocation on this CPU.

config NET_IPFILTER_POOL_SECTION_CPU4
	string "Section name of IP filter entry pool for CPU4"

endif # NCPUS > 4

if NCPUS > 5

config NET_IPFILTER_POOL_PREALLOC_CPU5
	int "Pre-allocated IP filter entries for CPU5"
	default 0
	range 0 65535
	---help---
		Number of statically pre-allocated IP filter entries for CPU5.
		IPv4 and IPv6 rules share this pool. Set to 0 to disable IP
		filter rule allocation on this CPU.

config NET_IPFILTER_POOL_SECTION_CPU5
	string "Section name of IP filter entry pool for CPU5"

endif # NCPUS > 5

endif # BMP

if !BMP

config NET_IPFILTER_POOL_PREALLOC
	int "Pre-allocated IP filter entries"
	default 0
	range 0 65535
	---help---
		Number of statically pre-allocated IP filter entries. IPv4 and
		IPv6 rules share this pool. Set to 0 to disable IP filter rule
		allocation.

config NET_IPFILTER_POOL_SECTION
	string "Section name of IP filter entry pool"

endif # !BMP

endif # NET_IPFILTER
```
